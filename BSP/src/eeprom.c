#include "stm32f10x.h"
#include "eeprom.h"	
#include "iic.h"	
#include "delay.h"

/**************************************************************************************
 * 描  述 : 在芯片AT24CXX指定地址读出一个数据
 * 入  参 : 开始读数据的地址
 * 返回值 : 读到的数据
 **************************************************************************************/
uint8_t AT24CXX_RcvOneByte(uint8_t Addr)
{				  
	uint8_t temp=0;		  	    																 
  IIC_Start();                                     //启动总线
	IIC_Send_Byte(0xA0);	                           //发送写命令
  IIC_Wait_Ack();	                                 //等待应答
  IIC_Send_Byte(Addr);                             //发送地址
	IIC_Wait_Ack();	                                 //等待应答	
  
	IIC_Start();  	 	                               //重新启动总线
	IIC_Send_Byte(0xA1);                             //设置为读模式			   
	IIC_Wait_Ack();		                               //等待应答 
  temp=IIC_Read_Byte(0x00);	                       //读字节，非应答		   
  IIC_Stop();                                      //结束总线    
	return temp;
}

/**************************************************************************************
 * 描  述 : 在芯片AT24CXX指定地址写入一个数据
 * 入  参 : Addr：写入的目的起始地址  Data：要写入的数据 
 * 返回值 : 无
 * 备  注 : 该函数针对的芯片是AT24C02~AT24C16
 **************************************************************************************/
void AT24CXX_SendOneByte(uint8_t Addr,uint8_t Data)
{				   	  	    																 
  IIC_Start();                                     //启动总线 
	IIC_Send_Byte(0xA0);	                           //发送写命令
	IIC_Wait_Ack();	                                 //等待应答
	IIC_Send_Byte(Addr);                             //发送地址
	IIC_Wait_Ack();		                               //等待应答   
  IIC_Send_Byte(Data);                             //发送字节数据
	IIC_Wait_Ack();		                               //等待应答
  		    	   
  IIC_Stop();                                      //结束总线
	sw_delay_ms(10);	                               //该延时保证连续发送字节的稳定性
}

/**************************************************************************************
 * 描  述 : 在芯片AT24CXX里面的指定地址开始写入长度为Len的数据
 * 入  参 : Addr：写入的目的起始地址  Data：要写入的数据  Len：要写入数据的长度（取值2或4）  
 * 返回值 : 无
 * 备  注 : 该函数针对的芯片是AT24C02~AT24C16
 **************************************************************************************/
void AT24CXX_SendLenByte(uint8_t Addr,uint8_t *Data,uint8_t Len)
{  	
	while(Len--)
	{
		AT24CXX_SendOneByte(Addr,*Data);
    Addr++;
    Data++;
	}												    
}

/**************************************************************************************
 * 描  述 : 在芯片AT24CXX里面的指定地址开始读出长度为Len的数据
 * 入  参 :  Addr：读出的目的起始地址  Data：读出的数据  Len：要读出数据的长度（取值2或4）
 * 返回值 : 无
 **************************************************************************************/
void AT24CXX_RcvLenByte(uint8_t Addr,uint8_t *Data,uint8_t Len)
{  	
	while(Len--)
	{
		*Data++ = AT24CXX_RcvOneByte(Addr++);
    Len--;
	}											    
}

/**************************************************************************************
 * 描  述 : 擦除芯片AT24CXX指定地址数据
 * 入  参 : Addr：要擦除的目的地址
 * 返回值 : 无
 **************************************************************************************/
void AT24CXX_EraseOneByte(uint8_t Addr)
{  	
	AT24CXX_SendOneByte(Addr,0xFF);												    
}

/************************************************************************************
功能描述：擦除整个芯片AT24CXX（即芯片存储单元数据都是0xFF）
入口参数：无
返回值：无
备注:   不同的存储芯片，存储空间不同，AT24CXX_SIZE数值不同。 注意uint8_t溢出问题。
*************************************************************************************/
void AT24CXX_EraseAll(void)
{  	
  uint16_t i;
	
	// 填充缓冲区
	for (i = 0; i < AT24CXX_SIZE; i++)
	{
		AT24CXX_SendOneByte(i,0xFF);
	}
  
}

/*********************************END FILE********************************************/	

